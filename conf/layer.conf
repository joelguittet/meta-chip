## conf/layer.conf
```bitbake
# We have a conf and classes directory, add to BBPATH
BBPATH .= ":${LAYERDIR}"

# We have a recipes-* directories, add to BBFILES
BBFILES += "${LAYERDIR}/recipes-*/*/*.bb \
    ${LAYERDIR}/recipes-*/*/*.bbappend"

BBFILE_COLLECTIONS += "meta-chip"
BBFILE_PATTERN_meta-chip = "^${LAYERDIR}/"
BBFILE_PRIORITY_meta-chip = "6"
```

## conf/machine/chip-pro.conf
```bitbake
#@TYPE: Machine
#@NAME: C.H.I.P. PRO board
#@DESCRIPTION: Machine configuration for C.H.I.P. PRO board

DEFAULTTUNE ?= "cortexa8t-neon"
include conf/machine/include/tune-cortexa8.inc

PREFERRED_PROVIDER_virtual/kernel ?= "linux-chip"
PREFERRED_PROVIDER_virtual/bootloader ?= "u-boot-chip"
PREFERRED_PROVIDER_u-boot ?= "u-boot-chip"

MACHINE_FEATURES = "bluetooth usbgadget usbhost wifi"

SERIAL_CONSOLES = "115200;ttyS0 115200;ttyGS0"

KERNEL_IMAGETYPE = "zImage"
KERNEL_DEVICETREE = "ntc-gr8-crumb.dtb"

IMAGE_FSTYPES += "ubi"
UBI_VOLNAME = "rootfs"
MKUBIFS_ARGS = "-e 0x3f000 -c 2000 -m 0x1000 -x lzo"
UBINIZE_ARGS = "-m 0x1000 -p 0x40000 -s 1024"
IMAGE_INSTALL_append = " kernel-devicetree kernel-image kernel-modules"

EXTRA_IMAGEDEPENDS += "u-boot-chip"
UBOOT_MACHINE = "chippro_defconfig"
```

## conf/machine/chip.conf
```bitbake
#@TYPE: Machine
#@NAME: C.H.I.P. board
#@DESCRIPTION: Machine configuration for C.H.I.P. board

DEFAULTTUNE ?= "cortexa8t-neon"
include conf/machine/include/tune-cortexa8.inc

# Required for ubi_test class
IMAGE_CLASSES += "ubi_multi_vol-chip"

PREFERRED_PROVIDER_virtual/kernel ?= "linux-chip"
PREFERRED_PROVIDER_virtual/bootloader ?= "u-boot-chip"
PREFERRED_PROVIDER_u-boot ?= "u-boot-chip"

MACHINE_FEATURES = "bluetooth usbgadget usbhost wifi"

SERIAL_CONSOLES = "115200;ttyS0 115200;ttyGS0"

KERNEL_IMAGETYPE = "zImage"
KERNEL_DEVICETREE = "sun5i-r8-chip.dtb"

IMAGE_FSTYPES += "tar.bz2"
UBIMULTIVOL_BUILD = "rootfs data conf boot"
#UBI_VOLNAME = "resin"
UBINIZE_ARGS = "-m 0x4000 -p 0x200000 -s 16384"
export MKUBIFS_ARGS_rootfs = "-e 0x1f8000 -c 500 -m 0x4000 -x lzo"
export ADDITIONAL_MKUBIFS_ARGS_rootfs = "-r ${IMAGE_ROOTFS} -o ${DEPLOY_DIR_IMAGE}/${IMAGE_NAME}.rootfs.ubifs"
export ADDITIONAL_UBINIZE_ARGS_rootfs = "mode=ubi\nimage=${DEPLOY_DIR_IMAGE}/${IMAGE_NAME}.rootfs.ubifs\nvol_id=0\nvol_type=dynamic\nvol_name=rootfs\nvol_flags=autoresize"

export MKUBIFS_ARGS_data = "-e 0x1f8000 -c 500 -m 0x4000 -x lzo"
export ADDITIONAL_MKUBIFS_ARGS_data = "-r /home/owner/resin-data -o ${DEPLOY_DIR_IMAGE}/data.ubifs"
export ADDITIONAL_UBINIZE_ARGS_data = "mode=ubi\nimage=${DEPLOY_DIR_IMAGE}/data.ubifs\nvol_id=1\nvol_type=dynamic\nvol_name=data"

export MKUBIFS_ARGS_conf = "-e 0x1f8000 -c 500 -m 0x4000 -x lzo"
export ADDITIONAL_MKUBIFS_ARGS_conf = "-r ${IMAGE_ROOTFS} -o ${DEPLOY_DIR_IMAGE}/${IMAGE_NAME}.conf.ubifs"
export ADDITIONAL_UBINIZE_ARGS_conf = "mode=ubi\nimage=${DEPLOY_DIR_IMAGE}/${IMAGE_NAME}.conf.ubifs\nvol_id=2\nvol_type=dynamic\nvol_name=conf"

export MKUBIFS_ARGS_boot = "-e 0x1f8000 -c 500 -m 0x4000 -x lzo"
export ADDITIONAL_MKUBIFS_ARGS_boot = "-r ${IMAGE_ROOTFS} -o ${DEPLOY_DIR_IMAGE}/${IMAGE_NAME}.boot.ubifs"
export ADDITIONAL_UBINIZE_ARGS_boot = "mode=ubi\nimage=${DEPLOY_DIR_IMAGE}/${IMAGE_NAME}.boot.ubifs\nvol_id=3\nvol_type=dynamic\nvol_name=boot"

IMAGE_INSTALL_append = " kernel-devicetree kernel-image kernel-modules"

EXTRA_IMAGEDEPENDS += "u-boot-chip"
UBOOT_MACHINE = "CHIP_defconfig"
```
